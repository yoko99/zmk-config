## boards/shields/m3d_q/Kconfig.defconfig
```kconfig
if SHIELD_M3D_Q_LEFT

config ZMK_KEYBOARD_NAME
    string
    default "m3d_q"

config ZMK_SPLIT
    bool
    default y

config ZMK_SPLIT_ROLE_CENTRAL
    bool
    default y

config ZMK_RGB_UNDERGLOW
    bool
    default y

config WS2812_STRIP
    bool
    default y

endif

if SHIELD_M3D_Q_RIGHT

config ZMK_SPLIT
    bool
    default y

config ZMK_SPLIT_ROLE_PERIPHERAL
    bool
    default y

endif
```

## config/west.yml
```yaml
manifest:
  defaults:
    revision: v0.3   # ← v0.3 から変更（最新版を使う）

  remotes:
    - name: zmkfirmware
      url-base: https://github.com/zmkfirmware
    - name: caksoylar
      url-base: https://github.com/caksoylar

  projects:
    - name: zmk
      remote: zmkfirmware
      import: app/west.yml

    - name: zmk-rgbled-widget
      remote: caksoylar
      revision: v0.3   # ← v0.3 → main に変更

  self:
    path: config
```
