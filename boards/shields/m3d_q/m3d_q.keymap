```pyson
#include <dt-bindings/zmk/keymap.h>

/ {
    keymap {
        compatible = "zmk,keymap";

        /* -----------------------------
         * 左手側（Left half）
         * ----------------------------- */
        left: left {
            label = "Left";
            layer0 = <
                K(Q) K(W) K(E) K(R) K(T)
                K(A) K(S) K(D) K(F) K(G)
                K(Z) K(X) K(C) K(V) K(B)
                K(1) K(2) K(3) K(4) K(5)
            >;
        };

        /* -----------------------------
         * 右手側（Right half）
         * ----------------------------- */
        right: right {
            label = "Right";
            layer0 = <
                K(Y) K(U) K(I) K(O) K(P)
                K(H) K(J) K(K) K(L) K(SCLN)
                K(N) K(M) K(COMM) K(DOT) K(SLSH)
                K(6) K(7) K(8) K(9) K(0)
            >;
        };
    };
};
